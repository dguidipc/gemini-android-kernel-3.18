## drivers/input/hall/Kconfig
```kconfig
config MTK_HALL
	tristate "MTK Hall Support"
	default n
	help
	  Say Y here if you have Eastaeon hall device.

	  If unsure, say Y.
```

## drivers/input/touchscreen/mediatek/aeon_nt36xxx/Kconfig
```kconfig
#
# Touchscreen driver configuration
#
config TOUCHSCREEN_MTK_NT36xxx
		tristate "NT36xxx for Mediatek package"
		default n
		help
			Say Y here if you have a Novatek NT36xxx Panel
			to the host processor over I2C

			If unsure, say N.
```

## drivers/misc/mediatek/accelerometer/lsm6ds3-new/Kconfig
```kconfig
config MTK_LSM6DS3A_NEW
	bool "LSM6DS3A_NEW for MediaTek package"
	default n
	help
	  It support different accelerometer sensor.
          If this option is set,
	  it will support
          LSM6DS3A_NEW Accelerometer.
```

## drivers/misc/mediatek/gyroscope/bmi160_gyro/Kconfig
```kconfig
config MTK_BMI160_GYRO
        bool "MTK_BMI160_GYRO for MediaTek package"
        default n
        help
        It support different gyroscope sensor.
        If this option is set,
	  	it will support
         BMI120 gyroscope.
```

## kernel-3.18/drivers/input/switch/Kconfig
```kconfig
config MTK_TOGGLE_SWITCH
	tristate "MTK TOGGLE_WITCH Support"
	default n
	help
	  Say Y here if you have Eastaeon TOGGLE_WITCH device for anti-tamper.

	  If unsure, say Y.
```

## kernel-3.18/drivers/input/touchscreen/mediatek/SSD209XX/Kconfig
```kconfig
#
# Touchscreen driver configuration
#
config TOUCHSCREEN_MTK_SSL_SSD20XX
	tristate "MediaTek Touch Panel Driver CONFIG_TOUCHSCREEN_MTK_SSL_SSD20XX"
	default n
	help
	  Say Y here if you have MediaTek touch panel.
	  If unsure, say N.
```

## kernel-3.18/drivers/misc/mediatek/aw9120/Kconfig
```kconfig
config MTK_AW9120
	tristate "MTK AW9120 Support"
	default n
	help
	  Say Y here if you have AW9120 led device.

	  If unsure, say Y.
```

## kernel-3.18/drivers/misc/mediatek/aw9523/Kconfig
```kconfig
config MTK_AW9523
	tristate "MTK AW9523 Support"
	default n
	help
	  Say Y here if you have AW9523 Key device.

	  If unsure, say Y.
```

## kernel-3.18/drivers/misc/mediatek/gyroscope/lsm6ds3-new/Kconfig
```kconfig
config MTK_LSM6DS3G_NEW
        bool "LSM6DS3G_NEW for MediaTek package"
        default n
	help
        It support different gyroscope sensor.
        If this option is set,
	  	it will support
         LSM6DS3G_NEW gyroscope.
```

## kernel-3.18/drivers/misc/mediatek/magnetometer/mmc3524xd/Kconfig
```kconfig
config MTK_MMC3524XD
        bool "YAS532 for Mediatek package"
        default n
	help
	  It support different magnetometer sensor.
          If this option is set,
	  it will support
          mmc3530 magnetometer.
```
