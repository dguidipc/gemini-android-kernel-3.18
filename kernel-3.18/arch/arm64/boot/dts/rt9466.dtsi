/* Copyright (c) 2016, The Linux Foundation. All rights reserved.
 *
 * This program is free software; you can redistribute it and/or modify
 * it under the terms of the GNU General Public License version 2 and
 * only version 2 as published by the Free Software Foundation.
 *
 * This program is distributed in the hope that it will be useful,
 * but WITHOUT ANY WARRANTY; without even the implied warranty of
 * MERCHANTABILITY or FITNESS FOR A PARTICULAR PURPOSE.  See the
 * GNU General Public License for more details.
 */
&i2c0 {
	rt9466@53 {
		compatible = "richtek,rt9466";
		reg = <0x53>;
		rt,intr_gpio_num = <246>;	/* direct defined GPIO num */
		rt,intr_gpio = <&pio 246 0>;
		interrupt-names = "wdtmri", "chg_mivr", "chg_aiclmeasi",
			"chg_statci";
		status = "okay";
		charger_name = "primary_charger";
		ichg = <2000000>;	/* uA */
		aicr = <500000>;	/* uA */
		mivr = <4400000>;	/* uV */
		cv = <4350000>;		/* uV */
		ieoc = <250000>;	/* uA */
		safety_timer = <12>;	/* hour */
		ircmp_resistor = <25000>;	/* uohm */
		ircmp_vclamp = <32000>;		/* uV */
		en_te;
		en_wdt;
		/* en_jeita; */
		/* en_irq_pulse; */
		/* ceb_invert; */
	};
};
